/*
 * ============================================================================
 *  NeuralCar.ino
 *  SmartAvoider + data logging + an on-board neural network
 *  ELEGOO Smart Robot Car V4.0 (TB6612 shield, HC-SR04 on servo, GY-521)
 * ============================================================================
 *
 *  Set MODE below, upload, and run:
 *
 *  MODE_SURVEY  The car does NOT drive. Every SURVEY_PERIOD_MS it sweeps the
 *               sensor and logs one training example. You carry/place the car
 *               in different spots (USB attached) between sweeps.
 *               -> safest way to collect data.
 *
 *  MODE_RULE    Drives with the hand-written rules (same as SmartAvoider) and
 *               logs every sweep. Needs a long USB cable for logging.
 *
 *  MODE_NN      Drives using the neural network in nn_weights.h to pick the
 *               heading. Still logs the rule's answer next to the network's,
 *               so you can measure agreement.
 *
 *  LOG LINE FORMAT (one per sweep, read by tools/capture.py):
 *    S,d0,d1,...,d12,ruleClass,nnClass
 *      d0..d12  : distances in cm at servo 0,15,...,180 deg (0 = full right)
 *      class    : 0..12 = heading index (rel. heading = 15*class - 90 deg)
 *                 13    = "boxed in" (no heading is open)
 *
 *  Everything else (pins, motor control, gyro turns, safety gates) is
 *  identical to SmartAvoider.ino; see the comments there.
 * ============================================================================
 */

#include <avr/pgmspace.h>   // PROGMEM: keeps the network weights in flash, not RAM
#include <Servo.h>
#include <Wire.h>
#include "nn_weights.h"   // generated by tools/train.py

// ============================================================================
//  PIN MAP (taken from ELEGOO's DeviceDriverSet_xxx0.h, TB6612 version)
// ============================================================================
const uint8_t PIN_PWMA   = 5;   // Motor A (RIGHT side) speed, PWM
const uint8_t PIN_AIN1   = 7;   // Motor A direction (HIGH = forward)
const uint8_t PIN_PWMB   = 6;   // Motor B (LEFT side) speed, PWM
const uint8_t PIN_BIN1   = 8;   // Motor B direction (HIGH = forward)
const uint8_t PIN_STBY   = 3;   // TB6612 standby: HIGH = drivers enabled

const uint8_t PIN_TRIG   = 13;  // HC-SR04 trigger
const uint8_t PIN_ECHO   = 12;  // HC-SR04 echo
const uint8_t PIN_SERVO  = 10;  // Servo carrying the ultrasonic sensor
const uint8_t PIN_KEY    = 2;   // MODE push-button on the shield (active LOW)

const uint8_t PIN_LINE_L = A2;  // Line-tracking sensors (ITR20001), analog
const uint8_t PIN_LINE_M = A1;
const uint8_t PIN_LINE_R = A0;
const uint8_t PIN_VOLT   = A3;  // Battery voltage divider

const uint8_t MPU_ADDR   = 0x68; // MPU6050 (GY-521) I2C address

// ============================================================================
//  TUNABLES: these are the numbers you will actually want to tweak
// ============================================================================

// ---- Operating mode (see header) ----
#define MODE_SURVEY 0
#define MODE_RULE   1
#define MODE_NN     2
const uint8_t  MODE             = MODE_SURVEY;  // <-- change this, re-upload
const uint16_t SURVEY_PERIOD_MS = 4000;         // time to reposition the car between sweeps

// ---- Speeds (PWM 0..255). Motors on this kit usually stall below ~60. ----
const uint8_t CRUISE_SPEED   = 110; // top forward speed in open space
const uint8_t MIN_SPEED      = 70;  // slowest forward speed near obstacles
const uint8_t TURN_SPEED     = 120; // in-place spin speed
const uint8_t REVERSE_SPEED  = 90;  // backing-up speed
const uint8_t RAMP_STEP      = 8;   // max PWM change per control cycle (smooth accel)

// Per-side trim in percent, to fix a car that drifts while "going straight".
// Drifts right -> lower LEFT_TRIM (or raise RIGHT_TRIM), and vice versa.
const uint8_t LEFT_TRIM_PCT  = 100;
const uint8_t RIGHT_TRIM_PCT = 100;

// ---- Distances (cm) ----
const uint16_t MAX_RANGE_CM  = 250; // readings beyond this (or timeouts) = "open"
const uint16_t STOP_DIST_CM  = 25;  // obstacle in path closer than this -> stop & scan
const uint16_t SLOW_DIST_CM  = 80;  // start slowing down from here
const uint16_t OPEN_DIST_CM  = 45;  // heading needs at least this much clearance
const uint16_t SCORE_CAP_CM  = 150; // clearance beyond this counts as "equally open"
const float    HALF_WIDTH_CM = 12.25;// half car width + margin. The .25 keeps integer
                                      // distances off the threshold (sin30 = 0.5 exactly)

// ---- Decision weights ----
const float    DEVIATION_PENALTY = 0.6; // cm of score lost per degree away from straight
const float    SAME_SIDE_BONUS   = 8.0; // bias toward last turn side (stops dithering)

// ---- Sweep ----
const uint8_t  SWEEP_STEP_DEG = 15;                     // 0,15,...,180 -> 13 readings
const uint8_t  SWEEP_N        = 180 / SWEEP_STEP_DEG + 1;
const int8_t   SERVO_TRIM_DEG = 0;   // if "90" isn't straight ahead, correct it here
const uint8_t  GLANCE_DEG     = 25;  // side-glance amplitude while driving

// ---- Turning ----
// Fallback when no gyro: ms of spinning per degree at TURN_SPEED.
// Calibrate: command turnBy(90) and adjust until it really turns 90 deg.
const float    TURN_MS_PER_DEG   = 4.5;
const float    GYRO_COAST_DEG    = 6.0; // stop this early; inertia carries the rest
const uint16_t ESCAPE_TURN_DEG   = 150; // turn amount when boxed in
const uint16_t REVERSE_MS        = 600; // back-up duration when boxed in

// ---- Start-up ----
const bool     AUTO_START     = true;  // true: start driving 3 s after power-on (no button needed)
const bool     LIFT_CHECK     = true;  // false: ignore line sensors (use if it never moves on dark floors)

// ---- Safety ----
const int      LIFT_THRESHOLD = 950;  // all 3 line sensors above this = lifted
const float    LOW_BATTERY_V  = 6.8;  // 2S Li-ion pack; ELEGOO's own cut-off is 7.0
const uint16_t STUCK_MS       = 2500; // no distance change this long = stuck
const uint8_t  STUCK_TOL_CM   = 3;    // "no change" tolerance

// ============================================================================
//  GLOBAL STATE
// ============================================================================
Servo   scanServo;
int     servoAngle   = 90;     // last commanded servo angle (logical, without trim)
bool    running      = false;  // toggled by the MODE button
bool    gyroOK       = false;  // MPU6050 detected at boot?
float   gyroBiasZ    = 0;      // raw gyro-Z offset measured at rest
int     curSpeed     = 0;      // current forward PWM (for ramping)
int8_t  lastTurnSide = 0;      // +1 = last turned left, -1 = right, 0 = none

uint16_t      stuckRefDist = 0;  // stall detector: last forward distance that "moved"
unsigned long stuckRefTime = 0;  // stall detector: when it last moved

uint16_t sweepDist[SWEEP_N];   // raw distances from the last sweep
uint16_t sweepClear[SWEEP_N];  // corridor clearance per heading

// ============================================================================
//  MOTORS
// ============================================================================

// Signed speeds: -255..255 per side. Positive = forward.
void setMotors(int left, int right) {
  left  = constrain(left,  -255, 255) * (int)LEFT_TRIM_PCT  / 100;
  right = constrain(right, -255, 255) * (int)RIGHT_TRIM_PCT / 100;

  digitalWrite(PIN_STBY, HIGH);                      // wake the driver

  digitalWrite(PIN_AIN1, right >= 0 ? HIGH : LOW);   // A = right side
  analogWrite (PIN_PWMA, abs(right));

  digitalWrite(PIN_BIN1, left >= 0 ? HIGH : LOW);    // B = left side
  analogWrite (PIN_PWMB, abs(left));
}

// Cut power and put the driver in standby (wheels coast to a stop).
void stopMotors() {
  analogWrite(PIN_PWMA, 0);
  analogWrite(PIN_PWMB, 0);
  digitalWrite(PIN_STBY, LOW);
  curSpeed = 0;
}

// Ramp forward speed toward a target, at most RAMP_STEP per call.
void driveForwardRamped(int target) {
  // Below MIN_SPEED the motors just hum without turning, so start there directly.
  if (curSpeed < MIN_SPEED) curSpeed = MIN_SPEED;
  if (curSpeed < target) curSpeed = min(curSpeed + RAMP_STEP, target);
  else                   curSpeed = max(curSpeed - RAMP_STEP, target);
  setMotors(curSpeed, curSpeed);
}

// ============================================================================
//  ULTRASONIC
// ============================================================================

// One raw ping. Timeout / no echo is treated as "open" (MAX_RANGE_CM).
uint16_t pingOnce() {
  digitalWrite(PIN_TRIG, LOW);
  delayMicroseconds(2);
  digitalWrite(PIN_TRIG, HIGH);
  delayMicroseconds(10);
  digitalWrite(PIN_TRIG, LOW);

  // Round trip: ~58 us per cm. Timeout just past max range so we never block long.
  unsigned long us = pulseIn(PIN_ECHO, HIGH, (unsigned long)MAX_RANGE_CM * 58UL + 1000UL);
  if (us == 0) return MAX_RANGE_CM;
  return (uint16_t)min((unsigned long)MAX_RANGE_CM, us / 58UL);
}

// Median of n pings (n <= 7). Kills the occasional garbage reading.
uint16_t pingMedian(uint8_t n) {
  uint16_t v[7];
  n = constrain(n, 1, 7);
  for (uint8_t i = 0; i < n; i++) {
    v[i] = pingOnce();
    delay(10);                                       // let echoes die out
  }
  // Insertion sort (n is tiny)
  for (uint8_t i = 1; i < n; i++) {
    uint16_t key = v[i];
    int8_t j = i - 1;
    while (j >= 0 && v[j] > key) { v[j + 1] = v[j]; j--; }
    v[j + 1] = key;
  }
  return v[n / 2];
}

// ============================================================================
//  SERVO
// ============================================================================

// Move the sensor head and wait just long enough for it to arrive.
// SG90 spec: ~0.17 s / 60 deg  ->  ~2.8 ms/deg, plus settle time.
void servoTo(int angle) {
  angle = constrain(angle, 0, 180);
  int delta = abs(angle - servoAngle);
  scanServo.write(constrain(angle + SERVO_TRIM_DEG, 0, 180));
  servoAngle = angle;
  if (delta > 0) delay(60 + delta * 3);
}

// ============================================================================
//  GYRO (MPU6050 via raw I2C, no library needed)
// ============================================================================

void mpuWrite(uint8_t reg, uint8_t val) {
  Wire.beginTransmission(MPU_ADDR);
  Wire.write(reg);
  Wire.write(val);
  Wire.endTransmission();
}

// Raw signed 16-bit Z-axis rate. 131 LSB per deg/s at the +/-250 dps range.
int16_t readGyroZRaw() {
  Wire.beginTransmission(MPU_ADDR);
  Wire.write(0x47);                                  // GYRO_ZOUT_H
  Wire.endTransmission(false);
  Wire.requestFrom(MPU_ADDR, (uint8_t)2);
  if (Wire.available() < 2) return 0;
  int16_t hi = Wire.read();
  int16_t lo = Wire.read();
  return (int16_t)((hi << 8) | lo);
}

// Detect the MPU6050, configure it, and measure the at-rest bias.
// Returns false if no chip answers (e.g. boards fitted with a QMI8658C instead).
bool gyroInit() {
  Wire.begin();
#if defined(WIRE_HAS_TIMEOUT)
  Wire.setWireTimeout(3000, true);                   // never hang on a bad bus
#endif
  Wire.beginTransmission(MPU_ADDR);
  if (Wire.endTransmission() != 0) return false;     // no ACK -> not present

  mpuWrite(0x6B, 0x01);  // PWR_MGMT_1: wake up, clock = gyro X PLL
  mpuWrite(0x1A, 0x03);  // CONFIG: digital low-pass ~44 Hz (less vibration noise)
  mpuWrite(0x1B, 0x00);  // GYRO_CONFIG: +/-250 deg/s
  delay(100);

  // Average 300 samples while the car is still -> bias
  long sum = 0;
  for (int i = 0; i < 300; i++) { sum += readGyroZRaw(); delay(2); }
  gyroBiasZ = sum / 300.0;
  return true;
}

// ============================================================================
//  TURNING
// ============================================================================

// Spin in place by `deg` degrees. Positive = LEFT (counter-clockwise).
void turnBy(int deg) {
  if (abs(deg) < 5) return;                          // not worth it
  int dir = (deg > 0) ? 1 : -1;
  lastTurnSide = dir;

  // Left spin: left wheels back, right wheels forward. Right spin: opposite.
  setMotors(-dir * TURN_SPEED, dir * TURN_SPEED);

  if (gyroOK) {
    // Closed loop: integrate |yaw rate| until we've rotated far enough.
    // Using the magnitude means we don't care about the chip's sign convention.
    float target = abs(deg) - GYRO_COAST_DEG;
    float yaw = 0;
    unsigned long tPrev = micros();
    unsigned long tStart = millis();
    unsigned long tLimit = (unsigned long)(abs(deg) * TURN_MS_PER_DEG * 2.5) + 500; // safety
    while (fabs(yaw) < target && millis() - tStart < tLimit) {
      float rate = (readGyroZRaw() - gyroBiasZ) / 131.0;   // deg/s
      unsigned long now = micros();
      yaw += rate * (now - tPrev) * 1e-6;
      tPrev = now;
    }
  } else {
    // Open loop: timed spin (calibrate TURN_MS_PER_DEG).
    delay((unsigned long)(abs(deg) * TURN_MS_PER_DEG));
  }

  stopMotors();
  delay(150);                                        // let the chassis settle
}

// ============================================================================
//  SWEEP + DECISION
// ============================================================================

// Full 0..180 sweep. Starts from whichever end is closer to save time.
void fullSweep() {
  bool ascending = (servoAngle <= 90);
  for (uint8_t k = 0; k < SWEEP_N; k++) {
    uint8_t i = ascending ? k : (SWEEP_N - 1 - k);
    servoTo(i * SWEEP_STEP_DEG);
    sweepDist[i] = pingMedian(3);
  }
  servoTo(90);
}

// For each candidate heading i, how far can a car-width corridor extend before
// it hits ANY obstacle point seen in the sweep?
//
// Obstacle j sits at angle a_j, distance d_j. Relative to heading a_i:
//   along   = d_j * cos(a_j - a_i)   (distance along the corridor)
//   lateral = d_j * |sin(a_j - a_i)| (sideways offset from corridor centre)
// If lateral < HALF_WIDTH and along > 0, it blocks the corridor at `along`.
void computeClearance() {
  for (uint8_t i = 0; i < SWEEP_N; i++) {
    float clear = MAX_RANGE_CM;
    for (uint8_t j = 0; j < SWEEP_N; j++) {
      if (sweepDist[j] >= MAX_RANGE_CM) continue;    // open reading, no obstacle point
      float dA = (int(j) - int(i)) * SWEEP_STEP_DEG * DEG_TO_RAD;
      float along   = sweepDist[j] * cos(dA);
      float lateral = sweepDist[j] * fabs(sin(dA));
      // along > 1.25 (not > 0): at exactly 90 deg cos() is ~0 and its sign
      // differs between float32 (UNO) and float64 (Python); the .25 keeps
      // integer distances off the threshold (cos60 = 0.5 exactly).
      if (along > 1.25 && lateral < HALF_WIDTH_CM && along < clear) clear = along;
    }
    sweepClear[i] = (uint16_t)clear;
  }
}

// Returns the best relative heading in degrees (+ = left), or INT16_MIN if boxed in.
int chooseHeading() {
  float bestScore = -1e9;
  int   best = INT16_MIN;
  for (uint8_t i = 0; i < SWEEP_N; i++) {
    if (sweepClear[i] < OPEN_DIST_CM) continue;      // not enough room
    int rel = (int)i * SWEEP_STEP_DEG - 90;          // -90 (right) .. +90 (left)
    float score = min(sweepClear[i], SCORE_CAP_CM)
                - DEVIATION_PENALTY * abs(rel);
    // Hysteresis: in a corridor, keep turning the same way instead of ping-ponging
    if (rel != 0 && ((rel > 0) == (lastTurnSide > 0)) && lastTurnSide != 0)
      score += SAME_SIDE_BONUS;
    if (score > bestScore) { bestScore = score; best = rel; }
  }
  return best;
}

// ============================================================================
//  LABELS + NEURAL NETWORK
// ============================================================================

const uint8_t CLASS_BOXED = SWEEP_N;   // 13 = "no open heading"

void printSweep();                      // defined below (forward declaration)

// Teacher label for the current sweep: the rule's choice WITHOUT hysteresis,
// so the label depends only on the 13 distances (a pure function the network
// can actually learn).
uint8_t ruleClass() {
  int8_t saved = lastTurnSide;
  lastTurnSide = 0;
  int rel = chooseHeading();
  lastTurnSide = saved;
  if (rel == INT16_MIN) return CLASS_BOXED;
  return (uint8_t)((rel + 90) / SWEEP_STEP_DEG);
}

// Forward pass of the 2-layer MLP stored in nn_weights.h:
//   x = feature / NN_IN_SCALE                 (13 inputs, ~0..1)
//       feature = corridor clearance (NN_FEATURES 1) or raw distance (0)
//   h = ReLU(W1 x + b1)                       (NN_HID hidden units)
//   z = W2 h + b2                             (14 class scores)
//   return argmax(z)                          (softmax not needed for argmax)
// Weights live in flash (PROGMEM) and are read with pgm_read_float().
uint8_t nnPredict(const uint16_t *f) {
  float x[NN_IN];
  for (uint8_t i = 0; i < NN_IN; i++) x[i] = f[i] / NN_IN_SCALE;

  float h[NN_HID];
  for (uint8_t j = 0; j < NN_HID; j++) {
    float s = pgm_read_float(&NN_B1[j]);
    for (uint8_t i = 0; i < NN_IN; i++) s += pgm_read_float(&NN_W1[j][i]) * x[i];
    h[j] = (s > 0) ? s : 0;                          // ReLU
  }

  uint8_t best = 0;
  float bestZ = -1e30;
  for (uint8_t k = 0; k < NN_OUT; k++) {
    float z = pgm_read_float(&NN_B2[k]);
    for (uint8_t j = 0; j < NN_HID; j++) z += pgm_read_float(&NN_W2[k][j]) * h[j];
    if (z > bestZ) { bestZ = z; best = k; }
  }
  return best;
}

// Check that the C forward pass reproduces Python's prediction on a stored
// test vector (catches export/ordering bugs before the car moves).
void nnSelfTest() {
  // The stored test vector is a raw sweep; build features exactly as at runtime.
  for (uint8_t i = 0; i < NN_IN; i++) sweepDist[i] = pgm_read_word(&NN_TEST_INPUT[i]);
  computeClearance();
  uint8_t got = nnPredict(NN_FEATURES == 1 ? sweepClear : sweepDist);
  Serial.print(F("NN self-test: expected ")); Serial.print(NN_TEST_EXPECT);
  Serial.print(F(", got ")); Serial.print(got);
  Serial.println(got == NN_TEST_EXPECT ? F("  OK") : F("  MISMATCH (re-export weights)"));
}

// Emit one machine-readable training line.
void logSweep(uint8_t ruleCls, uint8_t nnCls) {
  Serial.print(F("S"));
  for (uint8_t i = 0; i < SWEEP_N; i++) { Serial.print(','); Serial.print(sweepDist[i]); }
  Serial.print(','); Serial.print(ruleCls);
  Serial.print(','); Serial.println(nnCls);
}

// Sweep, compute clearances, log. Returns both opinions via references.
void senseAndLog(uint8_t &ruleCls, uint8_t &nnCls) {
  fullSweep();
  computeClearance();
  printSweep();
  ruleCls = ruleClass();
  nnCls   = nnPredict(NN_FEATURES == 1 ? sweepClear : sweepDist);
  logSweep(ruleCls, nnCls);
}

// Print the sweep table to Serial Monitor.
void printSweep() {
  Serial.println(F("--- sweep (rel deg: raw cm / corridor cm) ---"));
  for (uint8_t i = 0; i < SWEEP_N; i++) {
    int rel = (int)i * SWEEP_STEP_DEG - 90;
    Serial.print(rel > 0 ? F(" L") : (rel < 0 ? F(" R") : F("  ")));
    Serial.print(abs(rel)); Serial.print(F("\t"));
    Serial.print(sweepDist[i]); Serial.print(F(" / "));
    Serial.println(sweepClear[i]);
  }
}

// Stop, scan, decide, turn. Handles the boxed-in case too.
void scanAndReorient() {
  stopMotors();
  delay(100);
  uint8_t ruleCls, nnCls;
  senseAndLog(ruleCls, nnCls);

  int rel;
  if (MODE == MODE_NN) {
    rel = (nnCls == CLASS_BOXED) ? INT16_MIN : (int)nnCls * SWEEP_STEP_DEG - 90;
    // Safety net: never follow the network straight into something it can see.
    if (rel != INT16_MIN && sweepClear[nnCls] < STOP_DIST_CM) {
      Serial.println(F("NN veto: chosen heading is blocked"));
      rel = INT16_MIN;
    }
    if (nnCls != ruleCls) Serial.println(F("(NN disagrees with rule)"));
  } else {
    rel = chooseHeading();                           // rule, with hysteresis
  }

  if (rel != INT16_MIN) {
    Serial.print(F("-> heading ")); Serial.println(rel);
    turnBy(rel);
    stuckRefTime = millis();                         // re-arm stall timer after moving
    return;
  }

  // Boxed in: back up, then turn most of the way round toward the more open side.
  Serial.println(F("-> boxed in: reversing"));
  setMotors(-REVERSE_SPEED, -REVERSE_SPEED);
  delay(REVERSE_MS);
  stopMotors();

  long leftSum = 0, rightSum = 0;                    // which half looked more open?
  for (uint8_t i = 0; i < SWEEP_N; i++) {
    int rel_i = (int)i * SWEEP_STEP_DEG - 90;
    if (rel_i > 0) leftSum += sweepDist[i];
    if (rel_i < 0) rightSum += sweepDist[i];
  }
  turnBy(leftSum >= rightSum ? (int)ESCAPE_TURN_DEG : -(int)ESCAPE_TURN_DEG);
  stuckRefTime = millis();                           // re-arm stall timer
  // The next loop() iteration will drive/scan again from the new orientation.
}

// ============================================================================
//  SAFETY INPUTS
// ============================================================================

bool isLifted() {
  if (!LIFT_CHECK) return false;
  return analogRead(PIN_LINE_L) > LIFT_THRESHOLD &&
         analogRead(PIN_LINE_M) > LIFT_THRESHOLD &&
         analogRead(PIN_LINE_R) > LIFT_THRESHOLD;
}

// ELEGOO's own calibration for the A3 divider (+8% compensation).
float batteryVolts() {
  float v = analogRead(PIN_VOLT) * 0.0375;
  return v * 1.08;
}

// Debounced press detector for the MODE button. True once per press.
bool buttonPressed() {
  static bool lastState = HIGH;
  static unsigned long lastChange = 0;
  bool s = digitalRead(PIN_KEY);
  if (s != lastState && millis() - lastChange > 40) {
    lastChange = millis();
    lastState = s;
    if (s == LOW) return true;                       // falling edge = press
  }
  return false;
}

// ============================================================================
//  SETUP
// ============================================================================
void setup() {
  Serial.begin(115200);

  pinMode(PIN_PWMA, OUTPUT);  pinMode(PIN_AIN1, OUTPUT);
  pinMode(PIN_PWMB, OUTPUT);  pinMode(PIN_BIN1, OUTPUT);
  pinMode(PIN_STBY, OUTPUT);
  pinMode(PIN_TRIG, OUTPUT);  pinMode(PIN_ECHO, INPUT);
  pinMode(PIN_KEY,  INPUT_PULLUP);
  stopMotors();

  scanServo.attach(PIN_SERVO, 500, 2400);            // ELEGOO's pulse range
  scanServo.write(90 + SERVO_TRIM_DEG);
  servoAngle = 90;
  delay(400);

  gyroOK = gyroInit();                               // keep the car still during boot!
  Serial.println(F("SmartAvoider ready."));
  Serial.print(F("Gyro: ")); Serial.println(gyroOK ? F("MPU6050 found (closed-loop turns)")
                                                   : F("not found (timed turns)"));
  Serial.print(F("Battery: ")); Serial.print(batteryVolts()); Serial.println(F(" V"));
  Serial.print(F("Line sensors L/M/R: "));
  Serial.print(analogRead(PIN_LINE_L)); Serial.print('/');
  Serial.print(analogRead(PIN_LINE_M)); Serial.print('/');
  Serial.print(analogRead(PIN_LINE_R));
  Serial.print(F("  (lifted if all > ")); Serial.print(LIFT_THRESHOLD); Serial.println(')');
  Serial.println(F("MODE button = start/stop."));
  nnSelfTest();
  Serial.print(F("Mode: "));
  Serial.println(MODE == MODE_SURVEY ? F("SURVEY (no driving)")
               : MODE == MODE_RULE   ? F("RULE (drive + log)") : F("NN (drive with network)"));

  if (MODE == MODE_SURVEY) return;                   // survey never drives

  if (AUTO_START) {
    Serial.println(F("Auto-start in 3 s..."));
    delay(3000);
    running = true;
    stuckRefTime = millis();
    Serial.println(F("== RUN =="));
    scanAndReorient();                               // look before the first move
  }
}

// Rate-limited "why am I not moving" message (once per 2 s).
void whyStopped(const __FlashStringHelper *msg, float value) {
  static unsigned long lastWarn = 0;
  if (millis() - lastWarn < 2000) return;
  lastWarn = millis();
  Serial.print(F("NOT MOVING: ")); Serial.print(msg); Serial.println(value);
}

// ============================================================================
//  MAIN LOOP: one control cycle per call (~0.1-0.2 s)
// ============================================================================
void loop() {
  // ---- Survey mode: stationary data collection ----
  if (MODE == MODE_SURVEY) {
    static unsigned long last = 0;
    if (millis() - last >= SURVEY_PERIOD_MS) {
      uint8_t ruleCls, nnCls;
      senseAndLog(ruleCls, nnCls);
      Serial.println(F("Move the car now..."));
      last = millis();                               // period starts after the sweep
    }
    return;
  }

  // ---- Start/stop button ----
  if (buttonPressed()) {
    running = !running;
    stopMotors();
    stuckRefTime = millis();                         // fresh stall timer
    servoTo(90);
    Serial.println(running ? F("== RUN ==") : F("== STOP =="));
    if (running) { delay(500); scanAndReorient(); }  // look before the first move
  }
  if (!running) return;

  // ---- Safety gates ----
  if (isLifted()) {
    stopMotors();
    whyStopped(F("lifted? middle line sensor = "), analogRead(PIN_LINE_M));
    return;
  }
  float vb = batteryVolts();
  if (vb < LOW_BATTERY_V) {
    stopMotors();
    whyStopped(F("battery low/off, volts = "), vb);
    return;
  }

  // ---- Glance pattern while driving: centre, right, centre, left ----
  static const int8_t glance[4] = {0, -(int8_t)GLANCE_DEG, 0, (int8_t)GLANCE_DEG};
  static uint8_t g = 0;
  int rel = glance[g];
  g = (g + 1) & 3;

  servoTo(90 + rel);
  uint16_t d = pingMedian(3);

  // Project the reading into the car's forward corridor
  float along   = d * cos(rel * DEG_TO_RAD);
  float lateral = d * fabs(sin(rel * DEG_TO_RAD));
  bool  inPath  = (lateral < HALF_WIDTH_CM);

  // ---- Obstacle in the path -> full scan ----
  if (inPath && along < STOP_DIST_CM) {
    scanAndReorient();
    return;
  }

  // ---- Stall detection (only from forward readings, and only when something is in range) ----
  if (rel == 0 && curSpeed < MIN_SPEED) {
    stuckRefTime = millis();                         // not driving yet -> can't be "stuck"
  } else if (rel == 0) {
    if (d >= MAX_RANGE_CM || abs((int)d - (int)stuckRefDist) > STUCK_TOL_CM) {
      stuckRefDist = d;                             // distance changed -> we're moving
      stuckRefTime = millis();
    } else if (millis() - stuckRefTime > STUCK_MS) {
      Serial.println(F("-> stuck"));
      setMotors(-REVERSE_SPEED, -REVERSE_SPEED);
      delay(REVERSE_MS);
      scanAndReorient();
      return;
    }
  }

  // ---- Speed proportional to forward clearance ----
  if (rel == 0) {
    int target;
    if (d >= SLOW_DIST_CM) target = CRUISE_SPEED;
    else target = map(d, STOP_DIST_CM, SLOW_DIST_CM, MIN_SPEED, CRUISE_SPEED);
    driveForwardRamped(constrain(target, MIN_SPEED, CRUISE_SPEED));
  } else {
    driveForwardRamped(curSpeed);                    // hold speed during side glances
  }
}
